/dts-v1/;
/plugin/;

/ {
	compatible = "radxa,cubie-a5e", "allwinner,sun55i-a527";

	fragment@0 {
		target = <&spi0>;
		__overlay__ {
			pinctrl-names = "default";
			pinctrl-0 = <&spi0_pc_pins>, <&spi0_cs0_pc_pin>;
			#address-cells = <1>;
			#size-cells = <0>;
			status = "okay";

			flash@0 {
				compatible = "winbond,w25q128fw", "jedec,spi-nor";
				reg = <0>;
				spi-max-frequency = <24000000>;
				vcc-supply = <&reg_cldo1>;
				status = "okay";
			};
		};
	};
};
